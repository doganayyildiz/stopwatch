#include <SPI.h>
#include <Wire.h>
#include <Adafruit_GFX.h>
#include <Adafruit_SSD1306.h>

Adafruit_SSD1306 display(-1);

// 'IMG_4308', 128x64px
const unsigned char beseylul [] PROGMEM = {
  0x00, 0x00, 0x00, 0x00, 0x00, 0x00, 0x00, 0x00, 0x00, 0x00, 0x00, 0x00, 0x00, 0x00, 0x00, 0x00,
  0x00, 0x00, 0x00, 0x00, 0x00, 0x00, 0x00, 0x00, 0x00, 0x00, 0x00, 0x00, 0x00, 0x00, 0x00, 0x00,
  0x00, 0x00, 0x00, 0x00, 0x00, 0x00, 0x00, 0x00, 0x00, 0x00, 0x00, 0x00, 0x00, 0x00, 0x00, 0x00,
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  0x00, 0x00, 0x00, 0x00, 0x00, 0x00, 0x00, 0x00, 0x00, 0x00, 0x00, 0x00, 0x00, 0x00, 0x00, 0x00
};

unsigned long yzaman = 0;
unsigned long ezaman;
float zaman = 0;

int dakika = 0;

int trigpin = 2;
int echopin = 3;
int durum = 0;
long sure;
long mesafe;

#define buton 4

void setup() {
  Serial.begin(9600);
  pinMode(trigpin, OUTPUT);
  pinMode(echopin, INPUT);
  pinMode(buton, INPUT);
  display.begin(SSD1306_SWITCHCAPVCC, 0x3C);
  display.clearDisplay();
  display.drawBitmap(0, 0,  beseylul, 128, 64, WHITE);
  display.display();
  delay(1500);


  display.clearDisplay();
  display.setTextColor(WHITE);
  display.setCursor(0, 0);
  display.setTextSize(2);
  display.println(" Developer\n");
  display.println("{D.YILDIZ}");
  display.display();
  delay(1500);

  display.clearDisplay();
  display.setTextColor(WHITE);
  display.setCursor(20, 20);
  display.setTextSize(4);
  display.println("0:0");
  display.display();

}

void loop() {

  sensor();

  Serial.println(durum);
  if (durum == 1) {
    do {
      sayac();
      if (int(zaman) == 60) {
        zaman = 0;
        dakika++;
      }
      display.clearDisplay();
      display.setTextColor(WHITE);
      display.setCursor(20, 20);
      display.setTextSize(4);
      display.print(dakika);
      display.print(":");
      display.println(int(zaman));
      display.display();
    }
    while (durum != 1);
  }


}

float sayac() {
  yzaman = millis();
  if (yzaman - ezaman > 10) {
    zaman = zaman + 0.35;
    ezaman = yzaman;
  }

  return zaman;
}

int sensor() {

  digitalWrite(trigpin, LOW);
  delay(1);
  digitalWrite(trigpin, HIGH);
  delay(1);
  digitalWrite(trigpin, LOW);
  sure = pulseIn(echopin, HIGH);
  mesafe = sure * 0.034 / 2;

  if (mesafe < 100) {

    durum += 1;
    return durum;

  }

}
